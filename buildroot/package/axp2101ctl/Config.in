## buildroot/package/axp2101ctl/Config.in
```kconfig
config BR2_PACKAGE_AXP2101CTL
	bool "axp2101ctl"
	help
	  User space helper for AXP2101 battery status, charge current
	  configuration and PMIC power key events.
```

## buildroot/package/btop/Config.in
```kconfig
config BR2_PACKAGE_BTOP
    bool "btop"
    depends on BR2_PACKAGE_BUSYBOX_SHOW_OTHERS
    depends on BR2_USE_MMU
    select BR2_PACKAGE_LIBTINFO
    help
      Resource monitor that shows usage and stats.
      https://github.com/aristocratos/btop
```

## linux_5.10/Documentation/devicetree/bindings/iio/imu/hxymos,icm42688p.yaml
```yaml
# SPDX-License-Identifier: (GPL-2.0-only OR BSD-2-Clause)
%YAML 1.2
---
$id: http://devicetree.org/schemas/iio/imu/hxymos,icm42688p.yaml#
$schema: http://devicetree.org/meta-schemas/core.yaml#

title: HuaXuanYang ICM-42688P 6-axis IMU

maintainers:
  - Zonhor <support@zonhor.com>

description: |
  The HuaXuanYang ICM-42688P is a 6-axis IMU with 3-axis accelerometer and
  3-axis gyroscope. It uses a flat 8-bit register map documented in
  ICM_42688P-HXY.pdf and is not register-compatible with InvenSense ICM-426xx.

properties:
  compatible:
    const: hxymos,icm42688p

  reg:
    description: I2C slave address (0x18 when SDO/SA0 is low, 0x19 when high)
    maxItems: 1

  interrupts:
    maxItems: 1

required:
  - compatible
  - reg

additionalProperties: false

examples:
  - |
    i2c {
      #address-cells = <1>;
      #size-cells = <0>;

      imu@18 {
        compatible = "hxymos,icm42688p";
        reg = <0x18>;
        interrupt-parent = <&gpio>;
        interrupts = <22 IRQ_TYPE_EDGE_RISING>;
      };
    };
```

## linux_5.10/Documentation/devicetree/bindings/power/supply/axp2101_battery.txt
```
* Binding for X-Powers AXP2101 battery power supply

Required properties:
- compatible: "x-powers,axp2101-battery-power-supply"

This child node is instantiated by the AXP2101 MFD driver and exposes
battery/charger information through the Linux power supply class.

Temperatures (when the TS pin has an external NTC and ADC/TS bias are
enabled by the driver):
- power_supply "temp"          : external NTC temperature (0.1 degC)
- power_supply "temp_ambient"  : PMIC die temperature (0.1 degC)
- thermal_zone type "axp2101-ntc" : same NTC reading (millidegC)
- thermal_zone type "axp2101-die" : same die reading (millidegC)

NTC conversion uses the AXP2101 datasheet 10kOhm@25C / 50uA lookup table.

Example:

&i2c1 {
	axp2101: pmic@34 {
		compatible = "x-powers,axp2101";
		reg = <0x34>;
		interrupt-parent = <&porta>;
		interrupts = <14 IRQ_TYPE_EDGE_FALLING>;
		wakeup-source;

		battery-power-supply {
			compatible = "x-powers,axp2101-battery-power-supply";
		};
	};
};
```

## linux_5.10/Documentation/devicetree/bindings/soc/cvitek/wifi_pin.txt
```
Cvitek wifi pin driver

Required properties:
- compatible: "cvitek,wifi-pin"
- poweron-gpio: Wifi chip / module total power on gpio

Optional properties:
- wakeup-gpio: Wifi -> SoC wake IRQ gpio (WIFI_WAKE_HOST)
- host-wake-gpio: SoC -> Wifi wake gpio (HOST_WAKE_WF)

Example:
	wifi_pin {
		compatible = "cvitek,wifi-pin";
		poweron-gpio = <&porta 15 GPIO_ACTIVE_HIGH>;
		host-wake-gpio = <&porte 3 GPIO_ACTIVE_HIGH>;
		wakeup-gpio = <&porte 5 GPIO_ACTIVE_HIGH>;
	};
```

## linux_5.10/drivers/iio/imu/icm42688p/Kconfig
```kconfig
# SPDX-License-Identifier: GPL-2.0-or-later

config ICM42688P_I2C
	tristate "HuaXuanYang ICM-42688P I2C driver"
	depends on I2C
	select REGMAP_I2C
	help
	  Driver for the HuaXuanYang ICM-42688P 6-axis IMU over I2C.
	  Register map follows ICM_42688P-HXY.pdf (not InvenSense ICM-426xx).

	  To compile as a module, choose M here. The module is icm42688p.
```
